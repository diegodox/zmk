## app/dts/bindings/behaviors/zmk,behavior-hold-tap-mod.yml
```yaml
# Copyright (c) 2025 The ZMK Contributors
# SPDX-License-Identifier: MIT

description: |
  A combined hold/tap behavior that also has a “mod” action
  whenever a specified modifier is held.
compatible: "zmk,behavior-hold-tap-mod"
include:
  - behavior-metadata.yaml

properties:
  label:
    type: string
    required: false
    description: Optional node label for this behavior instance.

  "#binding-cells":
    type: int
    required: true
    const: 1

  bindings:
    type: phandle-array
    required: true
    description: |
      A list of three behaviors, in this order:
        • bindings[0]: tap behavior (quick press)
        • bindings[1]: hold behavior (long press)
        • bindings[2]: mod behavior  (when mods are active)

  mods:
    type: int
    required: true
    description: |
      Bitmask of modifiers that activate the “mod” behavior.
      (e.g. <MOD_LSFT | MOD_LCTL>)

  tapping-term-ms:
    type: int
    required: true
    description: |
      Duration in milliseconds to distinguish a tap from a hold.

binding-cells:
  - param1
  - param2
  - param3
```

## app/dts/bindings/behaviors/zmk,behavior-tap-mod-sensitive.yaml
```yaml
# Copyright (c) 2020 The ZMK Contributors
# SPDX-License-Identifier: MIT

description: Tap Mod Sensitive Behavior

compatible: "zmk,behavior-tap-mod-sensitive"

properties:
  label:
    type: string
    required: false
    deprecated: true
  "#binding-cells":
    type: int
    required: true
    const: 3

binding-cells:
  - param1
  - param2
  - param3
```
