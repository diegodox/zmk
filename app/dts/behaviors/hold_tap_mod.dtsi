/*
 * Copyright (c) 2025
 * SPDX-License-Identifier: MIT
 *
 * Generic &htm behavior:
 * - param1 = keycode for tap behavior
 * - param2 = keycode for hold behavior
 * - param3 = keycode for mod-triggered behavior
 * - param4 = bitmask of modifiers that activate mod behavior
 */

#include <dt-bindings/zmk/keys.h>

/ {
    behaviors {
#if ZMK_BEHAVIOR_OMIT(HTM)
        /omit-if-no-ref/
#endif
        htm: htm {
            compatible = "zmk,behavior-hold-tap-mod";
            #binding-cells = <3>;
            bindings = <&kp A &kp B &kp C>;
            mods = <(MOD_LSFT|MOD_RSFT)>;
            tapping-term-ms = <200>;
        };
    };
};
